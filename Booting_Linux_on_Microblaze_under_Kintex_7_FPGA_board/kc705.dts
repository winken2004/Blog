/*
 * CAUTION: This file is automatically generated by Xilinx.
 * Version:  
 * Today is: Fri Sep 23 16:19:47 2016
*/


/dts-v1/;
/include/ "pl.dtsi"
/ {
	chosen {
		bootargs = "console=ttyUL0,115200";
		linux,stdout-path = &axi_uartlite_0;
		stdout-path = &axi_uartlite_0;
	};
	aliases {
		serial0 = &axi_uartlite_0;
	};
	memory {
		device_type = "memory";
		reg = <0x80000000 0x40000000>;
	};
};
